## boards/arm/lumen/Kconfig
```kconfig
# Copyright (c) 2021 Nordic Semiconductor ASA
# Copyright (c) 2023 Leon Rinkel
# SPDX-License-Identifier: Apache-2.0

if BOARD_LUMEN

config BOARD_ENABLE_DCDC
	bool "Enable DCDC mode"
	select SOC_DCDC_NRF52X
	default y

config BOARD_ENABLE_DCDC_HV
	bool "High Voltage DCDC converter"
	select SOC_DCDC_NRF52X_HV
	default y

endif # BOARD_LUMEN
```

## boards/arm/lumen/Kconfig.board
```kconfig
# Copyright (c) 2021 Nordic Semiconductor ASA
# Copyright (c) 2023 Leon Rinkel
# SPDX-License-Identifier: Apache-2.0

config BOARD_LUMEN
	bool "lumen Board"
	depends on SOC_NRF52840_QIAA
```

## boards/arm/lumen/Kconfig.defconfig
```kconfig
# Copyright (c) 2021 Nordic Semiconductor ASA
# Copyright (c) 2023 Leon Rinkel
# SPDX-License-Identifier: Apache-2.0

if BOARD_LUMEN

config BOARD
	default "lumen"

config BT_CTLR
	default BT

endif # BOARD_LUMEN
```

## drivers/Kconfig
```kconfig
# Copyright (c) 2021 Nordic Semiconductor ASA
# Copyright (c) 2023 Leon Rinkel
# SPDX-License-Identifier: Apache-2.0

menu "Drivers"

if LED_STRIP
rsource "ws2812/Kconfig"
endif # LED_STRIP

endmenu
```

## lib/Kconfig
```kconfig
# Copyright (c) 2021 Legrand North America, LLC.
# Copyright (c) 2023 Leon Rinkel
# SPDX-License-Identifier: Apache-2.0

menu "Libraries"
endmenu
```

## west.yml
```yaml
# Copyright (c) 2021 Nordic Semiconductor ASA
# Copyright (c) 2023 Leon Rinkel
# SPDX-License-Identifier: Apache-2.0

manifest:
  remotes:
    - name: ncs
      url-base: https://github.com/nrfconnect

  projects:
    - name: nrf
      remote: ncs
      repo-path: sdk-nrf
      revision: v2.5.0-rc2
      import: true
```
